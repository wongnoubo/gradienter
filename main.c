#include<reg52.h>
#include<intrins.h>
#include<math.h>

#define uchar unsigned char
#define uint unsigned int

#define high 1
#define low 0

#define	Brightness	0xCF 
#define X_WIDTH 	128
#define Y_WIDTH 	64
#define N           15

sbit  SCL = P0^0;                                               //OLED串行时钟
sbit  SDA = P0^1;                                               //OLED串行数据
sbit SCLK = P2^7;												//ADXL345时钟信号
sbit  SDI = P2^6;												//ADXL345数据读写端
sbit   CS = P2^5;												//ADXL345片选信号

void delay_ms(uchar ms);	
void OLED_Init();		  
void OLED_WrCmd(unsigned char IIC_Command);	   
void OLED_Fill(unsigned char bmp_dat);		
void OLED_Set_Pos(unsigned char x, unsigned char y); 
void IIC_Start();
void Write_IIC_Byte(unsigned char IIC_Byte);
void IIC_Stop();					  
void OLED_WrDat(unsigned char IIC_Data);
void OLED_CLS(void);

void ADXL345_init();
void Write_Data(uchar Adress_Reg,uchar Data_write);
void Read_Data();
uchar Read_Data_Reg(uchar Adress_Reg);
void transform();			   
int filterx(int val);	
int filtery(int val);

uint Data_X_2[2];
uint Data_Y_2[2];
int Data_X;Data_Y;
uchar X,Y;	  
uchar kx,ky;
int value_bufx[N]=0;
int value_bufy[N]=0;

unsigned char code BMP2[] =
{
0x00,0x00,0x00,0x00,0x00,0x00,0x00,0x00,0x00,0x00,0x00,0x00,0x00,0x00,0x00,0x00,
0x00,0x00,0x00,0x00,0x00,0x00,0x00,0x00,0x00,0x00,0x00,0x00,0x00,0x00,0x00,0x00,
0x00,0x00,0x00,0x00,0x00,0x00,0x00,0x00,0x00,0x00,0x00,0x00,0x00,0x00,0x00,0x00,
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0x00,0x00,0x00,0x00,0x00,0x00,0x00,0x00,0x00,0x00,0x00,0x00,0x00,0x00,0x00,0x00,
};				   
unsigned char code BMP[] =
{
0x00,0x00,0x00,0x00,0x00,0x00,0x00,0x00,0x00,0x00,0x00,0x00,0x00,0x00,0x00,0x00,
0x00,0x00,0x00,0x00,0x00,0x00,0x00,0x00,0x00,0x00,0x00,0x00,0x00,0x00,0x00,0x00,
0x00,0x00,0x00,0x00,0x00,0x00,0x00,0x00,0x00,0x00,0x00,0x00,0x00,0x00,0x00,0x00,
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0x00,0x00,0x00,0x00,0x00,0x00,0x00,0x00,0x00,0x00,0x00,0x00,0x00,0x00,0x00,0x00,
};

void main()
{
	int x,y,x1,y1=0;
	int RR=0;
	float xx,yy;
	int dataxa=0,dataya=0;
	uchar num0,num1,num2;
	OLED_Init(); //OLED初始化
	ADXL345_init();
	OLED_Set_Pos(0,0);
	for(x=0;x<128;x++)
	{
		for(y=0;y<64;y=y+8)
		{
			OLED_WrDat(BMP2[8*x+y/8]);	
		}
	}
	delay_ms(1000);
	OLED_Set_Pos(0,0);
	for(x=0;x<128;x++)
	{
		for(y=0;y<64;y=y+8)
		{
			OLED_WrDat(BMP[8*x+y/8]);	
		}
	}	
	while(1)
	{
		Read_Data();
		transform();
		if(Data_X>999)
			Data_X=999;
		if(Data_Y>999)
			Data_Y=999;
		Data_X=Data_X/10;
		Data_Y=Data_Y/10;
		//滤波
		dataxa=filterx(Data_X);
		dataya=filtery(Data_Y);	 
		//矫正
		dataxa=dataxa-1;
		dataya=dataya+2;
		//限位
		RR=dataxa*dataxa+dataya*dataya;
		if(RR>784)
		{
			xx=dataxa*dataxa*784.0/RR;
			yy=dataya*dataya*784.0/RR;
			if(dataya>0)
				x=60-sqrt(yy);
			else
				x=60+sqrt(yy);
			if(dataxa>0)
				y=28+sqrt(xx);
			else
				y=28-sqrt(xx);
		}
		else
		{
			x=60-dataya;
			y=28+dataxa;
		}
		//x范围0~120，y范围0~56，中心点坐标(60,28)
		//覆盖圆圈
		OLED_Set_Pos(x1,y1/8);
		OLED_WrDat(BMP[8*x1+y1/8]);
		OLED_WrDat(BMP[8*x1+y1/8+1]);
		OLED_Set_Pos(x1+1,y1/8);
		OLED_WrDat(BMP[8*(x1+1)+y1/8]);
		OLED_WrDat(BMP[8*(x1+1)+y1/8+1]);
		OLED_Set_Pos(x1+2,y1/8);
		OLED_WrDat(BMP[8*(x1+2)+y1/8]);
		OLED_WrDat(BMP[8*(x1+2)+y1/8+1]);
		OLED_Set_Pos(x1+3,y1/8);
		OLED_WrDat(BMP[8*(x1+3)+y1/8]);
		OLED_WrDat(BMP[8*(x1+3)+y1/8+1]);
		OLED_Set_Pos(x1+4,y1/8);
		OLED_WrDat(BMP[8*(x1+4)+y1/8]);
		OLED_WrDat(BMP[8*(x1+4)+y1/8+1]);
		OLED_Set_Pos(x1+5,y1/8);
		OLED_WrDat(BMP[8*(x1+5)+y1/8]);
		OLED_WrDat(BMP[8*(x1+5)+y1/8+1]);
		OLED_Set_Pos(x1+6,y1/8);
		OLED_WrDat(BMP[8*(x1+6)+y1/8]);
		OLED_WrDat(BMP[8*(x1+6)+y1/8+1]);
		OLED_Set_Pos(x1+7,y1/8);
		OLED_WrDat(BMP[8*(x1+7)+y1/8]);
		OLED_WrDat(BMP[8*(x1+7)+y1/8+1]);
		if((x==60||x==59||x==61)&&(y==28||y==26||y==27))   //正好在中心
		{
			num0=0x3c;
			num1=0x7e;
			num2=0xff;
		}
		else
		{
			num0=0x3c;
			num1=0x42;
			num2=0x81;
		}
		OLED_Set_Pos(x,y/8);
		OLED_WrDat(BMP[8*(x+0)+y/8]|(num0<<y%8));
		OLED_WrDat(BMP[8*(x+0)+y/8+1]|(num0>>(8-y%8)));
		OLED_Set_Pos(x+1,y/8);
		OLED_WrDat(BMP[8*(x+1)+y/8]|(num1<<y%8));
		OLED_WrDat(BMP[8*(x+1)+y/8+1]|(num1>>(8-y%8)));
		OLED_Set_Pos(x+2,y/8);
		OLED_WrDat(BMP[8*(x+2)+y/8]|(num2<<y%8));
		OLED_WrDat(BMP[8*(x+2)+y/8+1]|(num2>>(8-y%8)));
		OLED_Set_Pos(x+3,y/8);
		OLED_WrDat(BMP[8*(x+3)+y/8]|(num2<<y%8));
		OLED_WrDat(BMP[8*(x+3)+y/8+1]|(num2>>(8-y%8)));
		OLED_Set_Pos(x+4,y/8);
		OLED_WrDat(BMP[8*(x+4)+y/8]|(num2<<y%8));
		OLED_WrDat(BMP[8*(x+4)+y/8+1]|(num2>>(8-y%8)));
		OLED_Set_Pos(x+5,y/8);
		OLED_WrDat(BMP[8*(x+5)+y/8]|(num2<<y%8));
		OLED_WrDat(BMP[8*(x+5)+y/8+1]|(num2>>(8-y%8)));
		OLED_Set_Pos(x+6,y/8);
		OLED_WrDat(BMP[8*(x+6)+y/8]|(num1<<y%8));
		OLED_WrDat(BMP[8*(x+6)+y/8+1]|(num1>>(8-y%8)));
		OLED_Set_Pos(x+7,y/8);
		OLED_WrDat(BMP[8*(x+7)+y/8]|(num0<<y%8));
		OLED_WrDat(BMP[8*(x+7)+y/8+1]|(num0>>(8-y%8)));	
		x1=x;
		y1=y;	 
	}
}

void delay_ms(uchar ms)
{
	uchar i;
	while(ms--)
	{
		for(i=0;i<250;i++)
		{
			_nop_();
			_nop_();
			_nop_();
			_nop_();
		}
	}
}

void OLED_Init(void)
{
	delay_ms(500);//初始化之前的延时很重要！
	OLED_WrCmd(0xae);//--turn off oled panel
	OLED_WrCmd(0x00);//---set low column address
	OLED_WrCmd(0x10);//---set high column address
	OLED_WrCmd(0x40);//--set start line address  Set Mapping RAM Display Start Line (0x00~0x3F)
	OLED_WrCmd(0x81);//--set contrast control register
	OLED_WrCmd(Brightness); // Set SEG Output Current Brightness
	OLED_WrCmd(0xa1);//--Set SEG/Column Mapping     0xa0左右反置 0xa1正常
	OLED_WrCmd(0xc8);//Set COM/Row Scan Direction   0xc0上下反置 0xc8正常
	OLED_WrCmd(0xa6);//--set normal display
	OLED_WrCmd(0xa8);//--set multiplex ratio(1 to 64)
	OLED_WrCmd(0x3f);//--1/64 duty
	OLED_WrCmd(0xd3);//-set display offset	Shift Mapping RAM Counter (0x00~0x3F)
	OLED_WrCmd(0x00);//-not offset
	OLED_WrCmd(0xd5);//--set display clock divide ratio/oscillator frequency
	OLED_WrCmd(0x80);//--set divide ratio, Set Clock as 100 Frames/Sec
	OLED_WrCmd(0xd9);//--set pre-charge period
	OLED_WrCmd(0xf1);//Set Pre-Charge as 15 Clocks & Discharge as 1 Clock
	OLED_WrCmd(0xda);//--set com pins hardware configuration
	OLED_WrCmd(0x12);
	OLED_WrCmd(0xdb);//--set vcomh
	OLED_WrCmd(0x40);//Set VCOM Deselect Level
	OLED_WrCmd(0x20);//-Set Addressing Mode (0x00/0x01/0x02)
	OLED_WrCmd(0x01);//
	OLED_WrCmd(0x8d);//--set Charge Pump enable/disable
	OLED_WrCmd(0x14);//--set(0x10) disable
	OLED_WrCmd(0xa4);// Disable Entire Display On (0xa4/0xa5)
	OLED_WrCmd(0xa6);// Disable Inverse Display On (0xa6/a7) 
	OLED_WrCmd(0xaf);//--turn on oled panel
	OLED_Fill(0x00); //初始清屏
	OLED_Set_Pos(0,0);
} 

void OLED_WrCmd(unsigned char IIC_Command)
{
	IIC_Start();
	Write_IIC_Byte(0x78);            //Slave address,SA0=0
	Write_IIC_Byte(0x00);			//write command
	Write_IIC_Byte(IIC_Command);
	IIC_Stop();
}

void OLED_Fill(unsigned char bmp_dat) 
{
	int i;
	OLED_Set_Pos(0,0);
	for(i=0;i<128*8;i++)
		OLED_WrDat(bmp_dat);
}

void OLED_Set_Pos(unsigned char x, unsigned char y) 
{ 
	OLED_WrCmd(0xb0+y);
	OLED_WrCmd(((x&0xf0)>>4)|0x10);
	OLED_WrCmd(x&0x0f);
} 

void IIC_Start()
{
   SCL = high;		
   SDA = high;
   SDA = low;
   SCL = low;
}

void Write_IIC_Byte(unsigned char IIC_Byte)
{
	unsigned char i;
	for(i=0;i<8;i++)
	{
		if(IIC_Byte & 0x80)
			SDA=high;
		else
			SDA=low;
		SCL=high;
		SCL=low;
		IIC_Byte<<=1;
	}
	SDA=1;
	SCL=1;
	SCL=0;
}

void IIC_Stop()
{
   SCL = low;
   SDA = low;
   SCL = high;
   SDA = high;
}

void OLED_WrDat(unsigned char IIC_Data)
{
	IIC_Start();
	Write_IIC_Byte(0x78);
	Write_IIC_Byte(0x40);			//write data
	Write_IIC_Byte(IIC_Data);
	IIC_Stop();
}

void ADXL345_init()
{
	Write_Data(0x31,0x4b);		  //寄存器DATA_FORMAT*  D7：禁用自测力；D6：3线SPI；D5：中断高电平有效；D4：0；D3：全分辨率模式；D2：左对齐模式；D1D0：测量范围正负16g；
	delay_ms(10);
	Write_Data(0x2C,0x08);		  //寄存器BW_RATE       D7D6D5：000；D4：非低功耗；D3D2D1D0：0111输出数据速率12.5HZ，带宽6.25HZ； 
	delay_ms(10);
	Write_Data(0x2D,0x08);		  //寄存器PWOER_CTL*    D7D6:00；D5：静止功能和活动功能同时进行；D4：禁止自动进入休眠模式；D3：测量模式（非待机模式）；D2：普通模式（非休眠模式）；D1D0：休眠模式下的数据读取速率；
	delay_ms(10);
	Write_Data(0x2E,0x80);		  //寄存器INT_ENABLE*   D7：使能DATA_READY中断；D6~D0：不使能其他中断；
	delay_ms(10);
	Write_Data(0x2F,0x00);		  //寄存器INT_MAP       D7：发送DATA_READY中断到INT1引脚；
	delay_ms(10);
	Write_Data(0x1E,0xfe);		  //寄存器OFSX          X轴偏移量11111110；（比例系数15.6mg/LSB；）
	delay_ms(10);
   	Write_Data(0x1F,0x00);		  //寄存器OFSY          Y轴偏移量00000000；
	delay_ms(10);
   	Write_Data(0x20,0xf7);		  //寄存器OFSZ          Z轴偏移量11110111；
	delay_ms(10);
	Write_Data(0x21,0x00);		  //寄存器DUR           敲击延时00000000：禁用单击/双击功能（比例系数625μs/LSB）；
	delay_ms(10);
	Write_Data(0x22,0x00);		  //寄存器latent		检测第一次敲击后的延时00000000：禁用双击功能（比例系数1.25ms/LSB）； 
	delay_ms(10);
	Write_Data(0x23,0x00);		  //寄存器Window		二次敲击延时00000000；禁用双击功能（比例系数1.25ms/LSB）；
	delay_ms(10);
	Write_Data(0x24,0x00);		  //寄存器THRESH_ACT	保存检测活动阀值00000000（比例系数62.5mg/LSB）；
	delay_ms(10);
	Write_Data(0x25,0x00);		  //寄存器THRESH_INACT  保存检测静止阀值00000000（比例系数62.5mg/LSB）；							   
	delay_ms(10);
	Write_Data(0x26,0x2b);		  //寄存器TIME_INACT	检测活动时间阀值00101011=43s（比例系数1s/LSB）；
	delay_ms(10);
	Write_Data(0x27,0x00);		  //寄存器ACT_INACT_CTL	D7~D0:00000000禁用活动、静止检测；
	delay_ms(10);
	Write_Data(0x28,0x09);		  //寄存器THRESH_FF		检测自由落体阀值00001001=600mg（比例系数62.5mg/LSB）；
	delay_ms(10);
	Write_Data(0x29,0xff);		  //寄存器TIME_FF		保存检测自由落体时间阀值11111111=1275ms（5ms/LSB）；
	delay_ms(10);
	Write_Data(0x2A,0x80);		  //寄存器TAP_AXES		D7~D4：0；
	delay_ms(10);
}

void Write_Data(uchar Adress_Reg,uchar Data_write)
{
	uchar i=0;
	Adress_Reg = (Adress_Reg & 0x7f);							//置最高位为0，写状态
	Adress_Reg = (Adress_Reg & 0xbf);                           //置第二高位0，单字读写

	CS=0;
	_nop_();		  
	SCLK=1;		
	_nop_();
	for(i=0;i<8;i++)	 
	{
		SCLK=0;		
		_nop_();	
		SDI=(bit)(Adress_Reg & 0x80);							//发送第一位数据
		_nop_();	
		_nop_();	
		_nop_();	
		SCLK=1;		
		_nop_();
		_nop_();
		Adress_Reg<<=1;		 									//数据串左移，准备发送第二位
	}
	for(i=0;i<8;i++)	
	{
		SCLK=0;		
		_nop_();
		SDI=(bit)(Data_write & 0x80);	
		_nop_();
		_nop_();
		_nop_();
		SCLK=1;		
		_nop_();	
		_nop_();	
		Data_write<<=1;		  
	}
	_nop_();	
	_nop_();	
	SCLK=1;		
	_nop_();
	_nop_();	
	SDI=1;		
	CS=1;
}

void Read_Data()	                                 
{
	Data_X_2[0]=Read_Data_Reg(0x32);                            //读出X轴低位			
	Data_X_2[1]=Read_Data_Reg(0x33);                            //读出X轴高位
	delay_ms(10);    
	Data_Y_2[0]=Read_Data_Reg(0x34);                            //读出Y轴低位
	Data_Y_2[1]=Read_Data_Reg(0x35);                            //读出Y轴高位
}

uchar Read_Data_Reg(uchar Adress_Reg)
{
	uchar i=0;
	uchar Data_Read;
	Adress_Reg=(Adress_Reg | 0x80);                             //置最高位为1，读状态
	Adress_Reg=(Adress_Reg & 0xbf);                             //置第二高位0，单字读写
	CS=0;
	_nop_();	
	_nop_();	
	SCLK=1;		
	_nop_();	
	_nop_();
	for(i=0;i<8;i++)	
	{
		SCLK=0;		
		_nop_();	
		SDI=(bit)(Adress_Reg & 0x80);	  
		_nop_();	
		_nop_();
		_nop_();
		SCLK=1;		
		_nop_();
		_nop_();	
		Adress_Reg<<=1;		 
	}
	for(i=0;i<8;i++)	
	{
		SCLK=0;	    
		Data_Read<<=1;	  									    //Data_Read左移1位
		_nop_();	
		Data_Read|=(uchar)SDI;	                                //将第一个数据存入Data_Read最低位
		_nop_();	
		_nop_();	
		SCLK=1;		
		_nop_();	
		_nop_();
	}
	_nop_();
	_nop_();	
	SCLK=1;	
	_nop_();	
	CS=1;
	return Data_Read;                                           //返回读取到的内容
}

void transform()	                                 
{
	Data_X=(Data_X_2[0])+(Data_X_2[1]<<8);		                
	Data_Y=(Data_Y_2[0])+(Data_Y_2[1]<<8);    
	
	if(Data_X&0x1000)
	{								   
		Data_X=(~Data_X)+1;			                            //若位负数，转换为补码
		X=0;						                            //标记符号-
		Data_X=Data_X*3.95;										//乘比例系数3.8
	}
	else
	{
		X=1;						                            //标记符号+
		Data_X=Data_X*3.7;			                            //乘比例系数3.78
	}
	if(Data_Y&0x1000)
	{								   
		Data_Y=(~Data_Y)+1;			   
		Y=0;						  
		Data_Y=Data_Y*3.8;			   
	}
	else
	{
		Y=1;						  
		Data_Y=Data_Y*3.95;			   
	}
}
  
int filterx(int val)
{
    unsigned char count;
    int sum=0;
    value_bufx[kx]=val;
	if(X==0)
		value_bufx[kx]=-value_bufx[kx];
	kx++;
    if(kx==N)
		kx=0;
    for(count=0;count<N;count++)
		sum+=value_bufx[count];
    return(int)(sum/N);
}
int filtery(int val)
{
    unsigned char count;
    int sum=0;
    value_bufy[ky]=val;	
	if(Y==0)
		value_bufy[ky]=-value_bufy[ky];
	ky++;
    if(ky==N)
		ky=0;
    for(count=0;count<N;count++)
		sum+=value_bufy[count];
    return(int)(sum/N);
}
